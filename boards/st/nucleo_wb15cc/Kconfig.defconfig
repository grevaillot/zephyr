## boards/st/nucleo_wb15cc/Kconfig.defconfig
```kconfig
# STM32WB15CC Nucleo board configuration

# Copyright (c) 2019 Linaro Limited
# Copyright (c) 2024 Wirestone
# SPDX-License-Identifier: Apache-2.0

if BOARD_NUCLEO_WB15CC

choice BT_HCI_BUS_TYPE
	default BT_STM32_IPM
	depends on BT
endchoice

endif
```

## boards/st/nucleo_wb15cc/Kconfig.nucleo_wb15cc
```kconfig
# Copyright (c) 2019 Linaro Limited
# SPDX-License-Identifier: Apache-2.0

config BOARD_NUCLEO_WB15CC
	select SOC_STM32WB15XX
```
